## sdkconfig.defaults
```kconfig
CONFIG_IDF_EXPERIMENTAL_FEATURES=y

CONFIG_FREERTOS_TIMER_TASK_STACK_DEPTH=8192
CONFIG_FREERTOS_HZ=1000

CONFIG_FATFS_LFN_HEAP=y
CONFIG_FATFS_MAX_LFN=255
CONFIG_FATFS_API_ENCODING_UTF_8=y

CONFIG_LILYGO_BOX_LOG_LEVEL_INFO=y

CONFIG_CPP_BUS_DRIVER_LOG_LEVEL_INFO=y

CONFIG_LILYGO_DEVICE_DRIVER_T_DISPLAY_P4=y
CONFIG_LILYGO_DEVICE_DRIVER_LOG_LEVEL_INFO=y

CONFIG_LV_USE_SYSMON=y
CONFIG_LV_USE_PERF_MONITOR=y
CONFIG_LV_PERF_MONITOR_ALIGN_BOTTOM_RIGHT=y
CONFIG_LV_USE_CLIB_MALLOC=y
CONFIG_LV_DEF_REFR_PERIOD=10
CONFIG_LV_FONT_MONTSERRAT_26=y
```
