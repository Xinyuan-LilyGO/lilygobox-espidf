## main/Kconfig.projbuild
```kconfig
menu "LilygoBox Configuration"
    config LILYGO_BOX_USB_ETHERNET
        bool
        depends on LILYGO_DEVICE_DRIVER_T_DISPLAY_P4 && LILYGO_DEVICE_DRIVER_DEVICE_VERSION_V2
        default y
        select USB_HOST_HUBS_SUPPORTED
        select USB_HOST_HUB_MULTI_LEVEL
        select USB_HOST_ENABLE_ENUM_FILTER_CALLBACK
        help
            P4 V2 uses the onboard hub and RTL8152B ECM configuration 2.

    choice LILYGO_BOX_LOG_LEVEL
        prompt "Select default LilygoBox log level"
        default LILYGO_BOX_LOG_LEVEL_INFO
        help
            Selects the minimum log level used when the application starts.
            The application can change it later through SetMinimumLogLevel().
        config LILYGO_BOX_LOG_LEVEL_DEBUG
            bool "Debug"
        config LILYGO_BOX_LOG_LEVEL_INFO
            bool "Info"
        config LILYGO_BOX_LOG_LEVEL_WARNING
            bool "Warning"
        config LILYGO_BOX_LOG_LEVEL_ERROR
            bool "Error"
        config LILYGO_BOX_LOG_LEVEL_NONE
            bool "None"
    endchoice

    choice LILYGO_BOX_RELEASE_CHANNEL
        prompt "Select LilygoBox release channel"
        default LILYGO_BOX_RELEASE_CHANNEL_STABLE
        help
            Selects the fixed application release channel used by this build.
            OTA manifests follow the same channel.
            The release lifecycle is Alpha (X.Y.Z-alpha.N), Beta
            (X.Y.Z-beta.N), and Stable (X.Y.Z).
            Production builds must use Stable.
        config LILYGO_BOX_RELEASE_CHANNEL_ALPHA
            bool "Alpha"
        config LILYGO_BOX_RELEASE_CHANNEL_BETA
            bool "Beta"
        config LILYGO_BOX_RELEASE_CHANNEL_STABLE
            bool "Stable"
    endchoice

endmenu
```

## sdkconfig.defaults.esp32p4
```kconfig
CONFIG_ESPTOOLPY_FLASHSIZE_16MB=y
CONFIG_PARTITION_TABLE_CUSTOM=y
CONFIG_PARTITION_TABLE_CUSTOM_FILENAME="partitions_esp32p4.csv"

CONFIG_SPIRAM=y
CONFIG_SPIRAM_MODE_HEX=y
CONFIG_SPIRAM_SPEED_200M=y
CONFIG_SPIRAM_XIP_FROM_PSRAM=y

CONFIG_CACHE_L2_CACHE_256KB=y
CONFIG_CACHE_L2_CACHE_LINE_128B=y
CONFIG_COMPILER_OPTIMIZATION_PERF=y

CONFIG_VFS_MAX_COUNT=16

CONFIG_ESP_WIFI_NVS_ENABLED=n
CONFIG_ESP_HOSTED_AUTO_INIT=n

# 为 ESP-Hosted SDIO 和硬件加密保留内部 DMA 内存。
CONFIG_SPIRAM_MALLOC_RESERVE_INTERNAL=65536

# 将大型 TLS 上下文和记录缓冲区分配到 PSRAM，避免占用紧张的内部内存。
# ESP-Hosted SDIO 的 DMA 缓冲区仍使用上方预留的内部 DMA 内存池。
CONFIG_MBEDTLS_EXTERNAL_MEM_ALLOC=y

CONFIG_CAMERA_SC2336=y
CONFIG_CAMERA_SC2336_MIPI_RAW8_1280x720_30FPS=n
CONFIG_CAMERA_SC2336_MIPI_RAW10_1280x720_30FPS=y

CONFIG_CAMERA_OV2710=y
CONFIG_CAMERA_OV2710_MIPI_RAW10_1280X720_25FPS=y
CONFIG_CAMERA_OV2710_MIPI_RAW10_1920X1080_25FPS=n

CONFIG_CAMERA_OV5645=y
CONFIG_CAMERA_OV5645_MIPI_RGB565_1280X960_30FPS=y
CONFIG_CAMERA_OV5645_MIPI_YUV422_1280X960_30FPS=n

CONFIG_ESP_VIDEO_ENABLE_ISP_PIPELINE_CONTROLLER=y
```
